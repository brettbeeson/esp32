## bts32/main/Kconfig.projbuild
```kconfig
menu "Battery Temperature Sensor"

    config BTS_SAMPLE_PERIOD_SEC
    int "Sample Period (s)"
    default 60

    config BTS_BULK_SEND
    int "Bulk send mulitpler"
    default 10

    config BTS_WIFI_SSID
    string "Wifi Network"
    default nickoff

    config BTS_WIFI_PASSWORD
    string "Wifi Password"
    default ""

    choice BTS_MAX_CPU_FREQ
        prompt "Maximum CPU frequency"
        default BTS_MAX_CPU_FREQ_80
        help
            Maximum CPU frequency to use for dynamic frequency scaling.

        config BTS_MAX_CPU_FREQ_80
            bool "80 MHz"
        config BTS_MAX_CPU_FREQ_160
            bool "160 MHz"
        config BTS_MAX_CPU_FREQ_240
            bool "240 MHz"
    endchoice

    config BTS_MAX_CPU_FREQ_MHZ
        int
        default 80 if BTS_MAX_CPU_FREQ_80
        default 160 if BTS_MAX_CPU_FREQ_160
        default 240 if BTS_MAX_CPU_FREQ_240

    choice BTS_MIN_CPU_FREQ
        prompt "Minimum CPU frequency"
        default BTS_MIN_CPU_FREQ_10M
        help
            Minimum CPU frequency to use for dynamic frequency scaling.
            Should be set to XTAL frequency or XTAL frequency divided by integer.

        config BTS_MIN_CPU_FREQ_40M
            bool "40 MHz (use with 40MHz XTAL)"
            depends on ESP32_XTAL_FREQ_40 || ESP32_XTAL_FREQ_AUTO
        config BTS_MIN_CPU_FREQ_20M
            bool "20 MHz (use with 40MHz XTAL)"
            depends on ESP32_XTAL_FREQ_40 || ESP32_XTAL_FREQ_AUTO
        config BTS_MIN_CPU_FREQ_10M
            bool "10 MHz (use with 40MHz XTAL)"
            depends on ESP32_XTAL_FREQ_40 || ESP32_XTAL_FREQ_AUTO
        config BTS_MIN_CPU_FREQ_26M
            bool "26 MHz (use with 26MHz XTAL)"
            depends on ESP32_XTAL_FREQ_26 || ESP32_XTAL_FREQ_AUTO
        config BTS_MIN_CPU_FREQ_13M
            bool "13 MHz (use with 26MHz XTAL)"
            depends on ESP32_XTAL_FREQ_26 || ESP32_XTAL_FREQ_AUTO
    endchoice

    config BTS_MIN_CPU_FREQ_MHZ
        int
        default 40 if BTS_MIN_CPU_FREQ_40M
        default 20 if BTS_MIN_CPU_FREQ_20M
        default 10 if BTS_MIN_CPU_FREQ_10M
        default 26 if BTS_MIN_CPU_FREQ_26M
        default 13 if BTS_MIN_CPU_FREQ_13M

endmenu
```

## bts32/sdkconfig.defaults
```kconfig
CONFIG_LOG_BOOTLOADER_LEVEL=2
CONFIG_ESPTOOLPY_BAUD=2000000
CONFIG_LOG_DEFAULT_LEVEL=2

CONFIG_MEMORYSAVER_MEASUREMENTS=8
CONFIG_MEMORYSAVER_SAMPLES=12
CONFIG_BTS_SAMPLE_PERIOD_SEC=600
CONFIG_BTS_BULK_SEND=6

CONFIG_BTS_WIFI_SSID="nickoff"
CONFIG_BTS_WIFI_PASSWORD="ititytno"

CONFIG_BTS_MAX_CPU_FREQ_MHZ=80
CONFIG_BTS_MIN_CPU_FREQ_MHZ=10
CONFIG_PM_ENABLE=y
CONFIG_PM_DFS_INIT_AUTO=y
CONFIG_FREERTOS_USE_TICKLESS_IDLE=y

CONFIG_CXX_EXCEPTIONS=y

CONFIG_MBEDTLS_PSK_MODES=y
CONFIG_MAKE_WARN_UNDEFINED_VARIABLES=n

CONFIG_ESPTOOLPY_FLASHSIZE="4MB"
```

## components/blobs/Kconfig.projbuild
```kconfig
menu "Blobs"
   
    config MEMORYSAVER_MEASUREMENTS
        int "Memory Saver Measurements"
        default 5
        range 1 100
        help 
        Such as "temperature" or "humidity"
        
    config MEMORYSAVER_SAMPLES
        int "Memory Saver Samples"
        default 30
        range 1 100
        help
         Number of samples of a measurement to allow to store usually before publishing
    
    config BLOB_QUEUE_0_LENGTH
        int "Length of the Readings queue (0)"
        default 30
        range 1 100
    
    config BLOB_QUEUE_1_LENGTH
        int "Length of the Readings queue (1)"
        default 30
        range 1 100
    


endmenu
```

## tlc32/main/Kconfig.projbuild
```kconfig
menu "Timelapse Camera"
    choice TLC32_MAX_CPU_FREQ
        prompt "Maximum CPU frequency"
        default TLC32_MAX_CPU_FREQ_240
        help
            Maximum CPU frequency to use for dynamic frequency scaling.

        config TLC32_MAX_CPU_FREQ_80
            bool "80 MHz"
        config TLC32_MAX_CPU_FREQ_160
            bool "160 MHz"
        config TLC32_MAX_CPU_FREQ_240
            bool "240 MHz"
    endchoice

    config TLC32_MAX_CPU_FREQ_MHZ
        int
        default 80 if TLC32_MAX_CPU_FREQ_80
        default 160 if TLC32_MAX_CPU_FREQ_160
        default 240 if TLC32_MAX_CPU_FREQ_240

    choice TLC32_MIN_CPU_FREQ
        prompt "Minimum CPU frequency"
        default TLC32_MIN_CPU_FREQ_10M
        help
            Minimum CPU frequency to use for dynamic frequency scaling.
            Should be set to XTAL frequency or XTAL frequency divided by integer.

        config TLC32_MIN_CPU_FREQ_40M
            bool "40 MHz (use with 40MHz XTAL)"
            depends on ESP32_XTAL_FREQ_40 || ESP32_XTAL_FREQ_AUTO
        config TLC32_MIN_CPU_FREQ_20M
            bool "20 MHz (use with 40MHz XTAL)"
            depends on ESP32_XTAL_FREQ_40 || ESP32_XTAL_FREQ_AUTO
        config TLC32_MIN_CPU_FREQ_10M
            bool "10 MHz (use with 40MHz XTAL)"
            depends on ESP32_XTAL_FREQ_40 || ESP32_XTAL_FREQ_AUTO
        config TLC32_MIN_CPU_FREQ_26M
            bool "26 MHz (use with 26MHz XTAL)"
            depends on ESP32_XTAL_FREQ_26 || ESP32_XTAL_FREQ_AUTO
        config TLC32_MIN_CPU_FREQ_13M
            bool "13 MHz (use with 26MHz XTAL)"
            depends on ESP32_XTAL_FREQ_26 || ESP32_XTAL_FREQ_AUTO
    endchoice

    config TLC32_MIN_CPU_FREQ_MHZ
        int
        default 40 if TLC32_MIN_CPU_FREQ_40M
        default 20 if TLC32_MIN_CPU_FREQ_20M
        default 10 if TLC32_MIN_CPU_FREQ_10M
        default 26 if TLC32_MIN_CPU_FREQ_26M
        default 13 if TLC32_MIN_CPU_FREQ_13M

endmenu
```

## tlc32/sdkconfig.defaults
```kconfig
# Fewer logs
CONFIG_LOG_DEFAULT_LEVEL=2
CONFIG_MAKE_WARN_UNDEFINED_VARIABLES=

# long filenames for date stamping files
CONFIG_FATFS_LFN_NONE=
CONFIG_FATFS_LFN_HEAP=y

# faster flash
CONFIG_ESPTOOLPY_BAUD=2000000

# test on CORE1 too
CONFIG_CAMERA_CORE0=
CONFIG_CAMERA_CORE1=y
CONFIG_CAMERA_NO_AFFINITY=

# spiram settings are important
CONFIG_SPIRAM_SUPPORT=y
CONFIG_SPIRAM_USE_MALLOC=y
CONFIG_SPIRAM_TYPE_AUTO=y

CONFIG_CXX_EXCEPTIONS=y

CONFIG_STACK_CHECK_NORM=y

# just to avoid compiler error
CONFIG_MBEDTLS_PSK_MODES=y

# bootloader
CONFIG_PARTITION_TABLE_FILENAME="partitions.csv"
CONFIG_ESPTOOLPY_FLASHSIZE="4MB"
CONFIG_PARTITION_TABLE_CUSTOM=y
CONFIG_PARTITION_TABLE_SINGLE_APP=

# powersvaer
CONFIG_PM_ENABLE=y
# todo: check power impact
CONFIG_ESP32_DEFAULT_CPU_FREQ_MHZ=240
```
